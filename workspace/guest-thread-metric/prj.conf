## CMakeLists.txt
```
# SPDX-License-Identifier: Apache-2.0

cmake_minimum_required(VERSION 3.13.1)

include(../common/guest.cmake NO_POLICY_SCOPE)

project(sample_app)

target_sources(app PRIVATE src/main.c)
target_sources(app PRIVATE $ENV{TM_DIR}/tm_porting_layer_zephyr.c)
```

## Kconfig
```
#
# Copyright (c) 2020 Yixiao Li <liyixiao7@gmail.com>
#
# SPDX-License-Identifier: Apache-2.0
#

source "$(WORKSPACE_DIR)/common/Kconfig.guest"
```

## prj.conf
```kconfig
# Common settings for benchmarking
CONFIG_BOOT_BANNER=n
CONFIG_ENTROPY_STM32_RNG=n
CONFIG_INIT_STACKS=n
CONFIG_FLOAT=n
CONFIG_LOG=y
CONFIG_MINIMAL_LIBC_MALLOC_ARENA_SIZE=1024
CONFIG_PRINTK=y
CONFIG_TEST_RANDOM_GENERATOR=y
CONFIG_THREAD_MONITOR=y
CONFIG_THREAD_NAME=y
CONFIG_TICKLESS_IDLE=n
CONFIG_TICKLESS_KERNEL=n

# Disable user space
CONFIG_ARM_MPU=n
CONFIG_USERSPACE=n

# Memory for guest software
CONFIG_FLASH_BASE_ADDRESS=0x8100000
CONFIG_FLASH_SIZE=512
CONFIG_SRAM_BASE_ADDRESS=0x20040000
CONFIG_SRAM_SIZE=64

# Settings for guest software
CONFIG_SHELL=n
CONFIG_ISOTEE_GUEST_USE_INTERRUPT_SUPPRESSED_CRITICAL_SECTION=y
CONFIG_SERIAL=n # Use semihosting for debug ouput
CONFIG_CORTEX_M_SYSTICK=n
```

## src/main.c
```c
/*
 * Copyright (c) 2020 Yixiao Li <liyixiao7@gmail.com>
 *
 * SPDX-License-Identifier: Apache-2.0
 */

#include <zephyr.h>
#include <misc/printk.h>
#include <shell/shell.h>
#include <shell/shell_uart.h>
#include <version.h>
#include <logging/log.h>
#include <stdlib.h>

extern int cmd_tm(const struct shell *shell, size_t argc, char **argv);

static char *argv[] = {"", "1"};

K_THREAD_DEFINE(CMD_TM_CALLER, 512/*STACKSIZE*/, cmd_tm, NULL, 2, argv, -CONFIG_NUM_COOP_PRIORITIES, 0, K_NO_WAIT);
```

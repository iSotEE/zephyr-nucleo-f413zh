## workspace/common/Kconfig.guest
```kconfig
#
# Copyright (c) 2020 Yixiao Li <liyixiao7@gmail.com>
#
# SPDX-License-Identifier: Apache-2.0
#

source "$(ISOTEE_DIR)/guest/zephyr/Kconfig"

source "Kconfig.zephyr"
```

## workspace/common/Kconfig.host
```kconfig
#
# Copyright (c) 2020 Yixiao Li <liyixiao7@gmail.com>
#
# SPDX-License-Identifier: Apache-2.0
#

source "$(ISOTEE_DIR)/host/Kconfig"

source "Kconfig.zephyr"
```

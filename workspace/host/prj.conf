## CMakeLists.txt
```
# SPDX-License-Identifier: Apache-2.0

cmake_minimum_required(VERSION 3.13.1)

include(../common/host.cmake NO_POLICY_SCOPE)

project(sample_app)

target_sources(app PRIVATE src/main.c)
```

## Kconfig
```
#
# Copyright (c) 2020 Yixiao Li <liyixiao7@gmail.com>
#
# SPDX-License-Identifier: Apache-2.0
#

source "$(WORKSPACE_DIR)/common/Kconfig.host"
```

## prj.conf
```kconfig
CONFIG_USERSPACE=y
CONFIG_SUPPORT_ISOTEE=y

# Memory for host
CONFIG_FLASH_BASE_ADDRESS=0x8000000
CONFIG_FLASH_SIZE=1024
CONFIG_SRAM_BASE_ADDRESS=0x20000000
CONFIG_SRAM_SIZE=256

# Memory for guest software
CONFIG_ISOTEE_GUEST_TASK_ENTRY=0x8100000
CONFIG_ISOTEE_GUEST_ROM_BASE=0x8100000
CONFIG_ISOTEE_GUEST_ROM_SIZE=0x80000
CONFIG_ISOTEE_GUEST_RAM_BASE=0x20040000
CONFIG_ISOTEE_GUEST_RAM_SIZE=0x10000

CONFIG_SHELL=y
CONFIG_INIT_STACKS=y

# For debug
CONFIG_BOOT_BANNER=n
CONFIG_LOG=y
CONFIG_PRINTK=y
CONFIG_THREAD_MONITOR=y
CONFIG_THREAD_NAME=y
```

## src/main.c
```c
/*
 * Copyright (c) 2020 Yixiao Li <liyixiao7@gmail.com>
 *
 * SPDX-License-Identifier: Apache-2.0
 */

#include <zephyr.h>
#include <misc/printk.h>
#include <shell/shell.h>
#include <shell/shell_uart.h>
#include <version.h>
#include <logging/log.h>
#include <stdlib.h>

static int cmd_guest(const struct shell *shell, size_t argc, char **argv)
{
	ARG_UNUSED(argc);
	ARG_UNUSED(argv);

	printf("Start iSotEE guest...\n");

    extern void _isotee_start_guest();
    _isotee_start_guest();

	return 0;
}

SHELL_CMD_ARG_REGISTER(guest, NULL, "Start iSotEE guest", cmd_guest, 1, 0);

void main(void)
{

}
```

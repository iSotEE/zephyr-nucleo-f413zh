## CMakeLists.txt
```
# SPDX-License-Identifier: Apache-2.0

cmake_minimum_required(VERSION 3.13.1)

include(../common/host.cmake NO_POLICY_SCOPE)

project(sample_app)

target_sources(app PRIVATE src/main.c)
target_sources(app PRIVATE $ENV{TM_DIR}/tm_porting_layer_zephyr.c)
```

## prj.conf
```kconfig
# Common settings for benchmarking
CONFIG_BOOT_BANNER=n
CONFIG_ENTROPY_STM32_RNG=n
CONFIG_INIT_STACKS=n
CONFIG_FLOAT=n
CONFIG_LOG=y
CONFIG_MINIMAL_LIBC_MALLOC_ARENA_SIZE=1024
CONFIG_PRINTK=y
CONFIG_TEST_RANDOM_GENERATOR=y
CONFIG_THREAD_MONITOR=y
CONFIG_THREAD_NAME=y
CONFIG_TICKLESS_IDLE=n
CONFIG_TICKLESS_KERNEL=n

# Enable user space
CONFIG_ARM_MPU=y
CONFIG_USERSPACE=y

# Memory for host software
CONFIG_FLASH_BASE_ADDRESS=0x8000000
CONFIG_FLASH_SIZE=1024
CONFIG_SRAM_BASE_ADDRESS=0x20000000
CONFIG_SRAM_SIZE=256

# Memory for guest software
CONFIG_ISOTEE_GUEST_TASK_ENTRY=0x8100000
CONFIG_ISOTEE_GUEST_ROM_BASE=0x8100000
CONFIG_ISOTEE_GUEST_ROM_SIZE=0x80000
CONFIG_ISOTEE_GUEST_RAM_BASE=0x20040000
CONFIG_ISOTEE_GUEST_RAM_SIZE=0x10000

# Settings for host software
CONFIG_SHELL=y
CONFIG_SUPPORT_ISOTEE=y
```

## src/main.c
```c
/*
 * Copyright (c) 2020 Yixiao Li <liyixiao7@gmail.com>
 *
 * SPDX-License-Identifier: Apache-2.0
 */

#include <zephyr.h>
#include <misc/printk.h>
#include <shell/shell.h>
#include <shell/shell_uart.h>
#include <version.h>
#include <logging/log.h>
#include <stdlib.h>

extern int cmd_tm(const struct shell *shell, size_t argc, char **argv);

static int cmd_guest(const struct shell *shell, size_t argc, char **argv)
{
	ARG_UNUSED(argc);
	ARG_UNUSED(argv);

	printf("Start iSotEE guest...\n");

    extern void _isotee_start_guest();
    _isotee_start_guest();

    static char *cmd_tm_argv[] = {"", "8"};
    cmd_tm(shell, 2, cmd_tm_argv);

	return 0;
}

SHELL_CMD_ARG_REGISTER(guest, NULL, "Start iSotEE guest", cmd_guest, 1, 0);

void main(void)
{
    #warning "USERSETMPEND is enabled for testing."
    SCB->CCR |= SCB_CCR_USERSETMPEND_Msk;
}
```
